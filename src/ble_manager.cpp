/**
 * @file ble_manager.cpp
 * @brief BLE peripheral implementation for HaykulTracker.
 *
 * GATT service layout (attribute indices used in notify calls):
 *
 *  [0]  Primary service declaration
 *  [1]  Buzzer char declaration   [2]  Buzzer char value
 *  [3]  Volume char declaration   [4]  Volume char value
 *  [5]  Alert Config declaration  [6]  Alert Config char value
 *  [7]  IMU Data char declaration [8]  IMU Data char value  [9]  IMU CCCD
 *  [10] Button Event declaration  [11] Button Event value   [12] Button CCCD
 *  [13] Alert Status declaration  [14] Alert Status value   [15] Alert CCCD
 *
 * NFC pairing uniqueness
 * ─────────────────────
 * The BLE advertising payload includes the full 128-bit Haykul service UUID
 * (BT_DATA_UUID128_ALL).  The NFC OOB record generated by nfc_manager.cpp
 * also embeds this UUID as an AD structure (type 0x07).  The Android app
 * validates the presence of this UUID before accepting an NFC pairing.
 */

#include "ble_manager.h"
#include <zephyr/bluetooth/bluetooth.h>
#include <zephyr/bluetooth/gatt.h>
#include <zephyr/bluetooth/uuid.h>
#include <zephyr/logging/log.h>
#include <zephyr/bluetooth/services/bas.h>

LOG_MODULE_REGISTER(ble_manager, LOG_LEVEL_INF);

/* ── Custom UUID Definitions ─────────────────────────────────────────────── */

/** Primary service UUID — used in advertising AND in NFC OOB AD structures
 *  to uniquely identify genuine HaykulTracker devices. */
#define BT_UUID_HAYKUL_VAL \
    BT_UUID_128_ENCODE(0x0000feaa, 0x0000, 0x1000, 0x8000, 0x00805f9b34fb)
#define BT_UUID_HAYKUL BT_UUID_DECLARE_128(BT_UUID_HAYKUL_VAL)

#define BT_UUID_BUZZER_VAL \
    BT_UUID_128_ENCODE(0x0000fe01, 0x0000, 0x1000, 0x8000, 0x00805f9b34fb)
#define BT_UUID_BUZZER BT_UUID_DECLARE_128(BT_UUID_BUZZER_VAL)

#define BT_UUID_IMU_VAL \
    BT_UUID_128_ENCODE(0x0000fe02, 0x0000, 0x1000, 0x8000, 0x00805f9b34fb)
#define BT_UUID_IMU BT_UUID_DECLARE_128(BT_UUID_IMU_VAL)

#define BT_UUID_VOLUME_VAL \
    BT_UUID_128_ENCODE(0x0000fe03, 0x0000, 0x1000, 0x8000, 0x00805f9b34fb)
#define BT_UUID_VOLUME BT_UUID_DECLARE_128(BT_UUID_VOLUME_VAL)

#define BT_UUID_ALERT_CFG_VAL \
    BT_UUID_128_ENCODE(0x0000fe04, 0x0000, 0x1000, 0x8000, 0x00805f9b34fb)
#define BT_UUID_ALERT_CFG BT_UUID_DECLARE_128(BT_UUID_ALERT_CFG_VAL)

#define BT_UUID_BTN_EVENT_VAL \
    BT_UUID_128_ENCODE(0x0000fe05, 0x0000, 0x1000, 0x8000, 0x00805f9b34fb)
#define BT_UUID_BTN_EVENT BT_UUID_DECLARE_128(BT_UUID_BTN_EVENT_VAL)

#define BT_UUID_ALERT_STATUS_VAL \
    BT_UUID_128_ENCODE(0x0000fe06, 0x0000, 0x1000, 0x8000, 0x00805f9b34fb)
#define BT_UUID_ALERT_STATUS BT_UUID_DECLARE_128(BT_UUID_ALERT_STATUS_VAL)

/* ── Global State ─────────────────────────────────────────────────────────── */

static BleManager::buzzer_callback_t       g_buzzer_cb       = nullptr;
static BleManager::volume_callback_t       g_volume_cb       = nullptr;
static BleManager::alert_config_callback_t g_alert_config_cb = nullptr;
static struct bt_conn                     *current_conn       = nullptr;

/* ── GATT Write Handlers ──────────────────────────────────────────────────── */

/**
 * @brief Handle writes to the Buzzer characteristic.
 *        Payload: 1 byte — 0x00 = off, any non-zero = on.
 */
static ssize_t write_buzzer(struct bt_conn *conn,
                             const struct bt_gatt_attr *attr,
                             const void *buf, uint16_t len, uint16_t offset,
                             uint8_t flags)
{
    if (len != 1) return BT_GATT_ERR(BT_ATT_ERR_INVALID_ATTRIBUTE_LEN);
    uint8_t value = *((const uint8_t *)buf);
    LOG_INF("Buzzer write: %s", value ? "ON" : "OFF");
    if (g_buzzer_cb) g_buzzer_cb(value > 0);
    return len;
}

/**
 * @brief Handle writes to the Volume characteristic.
 *        Payload: 1 byte — 0–100 (%).  Values above 100 are clamped.
 */
static ssize_t write_volume(struct bt_conn *conn,
                             const struct bt_gatt_attr *attr,
                             const void *buf, uint16_t len, uint16_t offset,
                             uint8_t flags)
{
    if (len != 1) return BT_GATT_ERR(BT_ATT_ERR_INVALID_ATTRIBUTE_LEN);
    uint8_t pct = *((const uint8_t *)buf);
    if (pct > 100U) pct = 100U;
    LOG_INF("Volume write: %d%%", pct);
    if (g_volume_cb) g_volume_cb(pct);
    return len;
}

/**
 * @brief Handle writes to the Alert Config characteristic.
 *        Payload: 1 byte — seconds before auto-ring on disconnect (0 = off).
 */
static ssize_t write_alert_cfg(struct bt_conn *conn,
                                const struct bt_gatt_attr *attr,
                                const void *buf, uint16_t len, uint16_t offset,
                                uint8_t flags)
{
    if (len != 1) return BT_GATT_ERR(BT_ATT_ERR_INVALID_ATTRIBUTE_LEN);
    uint8_t secs = *((const uint8_t *)buf);
    LOG_INF("Alert config write: %d s disconnect timeout", secs);
    if (g_alert_config_cb) g_alert_config_cb(secs);
    return len;
}

/* ── GATT Service Definition ──────────────────────────────────────────────── */

BT_GATT_SERVICE_DEFINE(haykul_svc,
    /* [0] Primary service */
    BT_GATT_PRIMARY_SERVICE(BT_UUID_HAYKUL),

    /* [1-2] Buzzer — write-only */
    BT_GATT_CHARACTERISTIC(BT_UUID_BUZZER,
                           BT_GATT_CHRC_WRITE,
                           BT_GATT_PERM_WRITE,
                           NULL, write_buzzer, NULL),

    /* [3-4] Volume — write-only (0–100 %) */
    BT_GATT_CHARACTERISTIC(BT_UUID_VOLUME,
                           BT_GATT_CHRC_WRITE,
                           BT_GATT_PERM_WRITE,
                           NULL, write_volume, NULL),

    /* [5-6] Alert Config — write-only (disconnect timeout in seconds) */
    BT_GATT_CHARACTERISTIC(BT_UUID_ALERT_CFG,
                           BT_GATT_CHRC_WRITE,
                           BT_GATT_PERM_WRITE,
                           NULL, write_alert_cfg, NULL),

    /* [7-9] IMU Data — notify */
    BT_GATT_CHARACTERISTIC(BT_UUID_IMU,
                           BT_GATT_CHRC_NOTIFY,
                           BT_GATT_PERM_READ,
                           NULL, NULL, NULL),
    BT_GATT_CCC(NULL, BT_GATT_PERM_READ | BT_GATT_PERM_WRITE),

    /* [10-12] Button Event — notify (0x01 = double-click) */
    BT_GATT_CHARACTERISTIC(BT_UUID_BTN_EVENT,
                           BT_GATT_CHRC_NOTIFY,
                           BT_GATT_PERM_READ,
                           NULL, NULL, NULL),
    BT_GATT_CCC(NULL, BT_GATT_PERM_READ | BT_GATT_PERM_WRITE),

    /* [13-15] Alert Status — notify (0x01 = proximity alert) */
    BT_GATT_CHARACTERISTIC(BT_UUID_ALERT_STATUS,
                           BT_GATT_CHRC_NOTIFY,
                           BT_GATT_PERM_READ,
                           NULL, NULL, NULL),
    BT_GATT_CCC(NULL, BT_GATT_PERM_READ | BT_GATT_PERM_WRITE),
);

/* Attribute index constants for notify calls */
static constexpr uint8_t ATTR_IDX_IMU        = 8U;
static constexpr uint8_t ATTR_IDX_BTN_EVENT  = 11U;
static constexpr uint8_t ATTR_IDX_ALERT_STATUS = 14U;

/* ── Connection Callbacks ─────────────────────────────────────────────────── */

void BleManager::connected(struct bt_conn *conn, uint8_t err)
{
    if (err) {
        LOG_ERR("Connection failed (err %u)", err);
        return;
    }
    LOG_INF("Central connected");
    current_conn = bt_conn_ref(conn);
}

void BleManager::disconnected(struct bt_conn *conn, uint8_t reason)
{
    LOG_INF("Central disconnected (reason 0x%02x)", reason);
    if (current_conn) {
        bt_conn_unref(current_conn);
        current_conn = nullptr;
    }
}

BT_CONN_CB_DEFINE(conn_callbacks) = {
    .connected    = BleManager::connected,
    .disconnected = BleManager::disconnected,
};

/* ── BleManager Implementation ───────────────────────────────────────────── */

BleManager::BleManager()
    : is_initialized(false),
      buzzer_cb(nullptr),
      volume_cb(nullptr),
      alert_config_cb(nullptr)
{}

BleManager::~BleManager() {}

int BleManager::init()
{
    int err = bt_enable(NULL);
    if (err) {
        LOG_ERR("bt_enable failed (err %d)", err);
        return err;
    }

    is_initialized = true;

    /*
     * Advertising payload: flags + full Haykul service UUID.
     * The 128-bit UUID is included so NFC OOB validation and BLE scan
     * filters both work with a single well-known identifier.
     */
    const struct bt_data ad[] = {
        BT_DATA_BYTES(BT_DATA_FLAGS, (BT_LE_AD_GENERAL | BT_LE_AD_NO_BREDR)),
        BT_DATA_BYTES(BT_DATA_UUID128_ALL, BT_UUID_HAYKUL_VAL),
    };

    const struct bt_data sd[] = {
        BT_DATA(BT_DATA_NAME_COMPLETE,
                CONFIG_BT_DEVICE_NAME,
                sizeof(CONFIG_BT_DEVICE_NAME) - 1),
    };

    err = bt_le_adv_start(BT_LE_ADV_CONN_FAST_1, ad, ARRAY_SIZE(ad), sd, ARRAY_SIZE(sd));
    if (err) {
        LOG_ERR("Advertising start failed (err %d)", err);
        return err;
    }

    LOG_INF("BLE advertising as \"%s\"", CONFIG_BT_DEVICE_NAME);
    return 0;
}

void BleManager::set_buzzer_callback(buzzer_callback_t cb)       { g_buzzer_cb       = cb; }
void BleManager::set_volume_callback(volume_callback_t cb)        { g_volume_cb       = cb; }
void BleManager::set_alert_config_callback(alert_config_callback_t cb) { g_alert_config_cb = cb; }

int BleManager::notify_imu_data(const uint8_t *data, uint16_t len)
{
    if (!current_conn) return -ENOTCONN;
    return bt_gatt_notify(current_conn, &haykul_svc.attrs[ATTR_IDX_IMU], data, len);
}

int BleManager::notify_button_event(uint8_t event)
{
    if (!current_conn) return -ENOTCONN;
    LOG_INF("Sending button event 0x%02x to phone", event);
    return bt_gatt_notify(current_conn, &haykul_svc.attrs[ATTR_IDX_BTN_EVENT], &event, 1);
}

int BleManager::notify_alert_status(uint8_t status)
{
    if (!current_conn) return -ENOTCONN;
    LOG_INF("Sending alert status 0x%02x to phone", status);
    return bt_gatt_notify(current_conn, &haykul_svc.attrs[ATTR_IDX_ALERT_STATUS], &status, 1);
}

int BleManager::update_battery_level(uint8_t level)
{
    return bt_bas_set_battery_level(level);
}

bool BleManager::is_connected() const
{
    return current_conn != nullptr;
}
